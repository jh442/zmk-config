## config/boards/shields/TheRunner/Kconfig.defconfig
```kconfig
if SHIELD_THERUNNER
            
config ZMK_KEYBOARD_NAME
    default "TheRunner"

endif
```

## config/boards/shields/runner65/Kconfig.defconfig
```kconfig
if SHIELD_RUNNER65
            
config ZMK_KEYBOARD_NAME
    default "Runner65"

endif
```
